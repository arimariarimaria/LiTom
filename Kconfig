## Kconfig
```kconfig
config LITOM_RECOVER_UNRESOLVED_BINDINGS
    bool "Recover unresolved saved key bindings in RAM"
    depends on ZMK_KEYMAP_SETTINGS_STORAGE && ZMK_BEHAVIOR_LOCAL_ID_TYPE_CRC16
    help
      Use stock bindings for saved behavior IDs that cannot be resolved.
      Does not erase or write settings; save explicitly from Studio after review.

config LITOM_PREFER_USB_ENDPOINT_ON_READY
    bool "Prefer USB endpoint when USB HID is ready"
    depends on ZMK_USB && ZMK_BLE
    help
      Switch the selected ZMK output endpoint back to USB whenever the USB HID
      endpoint becomes ready. This keeps BLE enabled for split transport while
      making host input prefer USB when a cable is connected.

menuconfig LITOM_IQS7222D_TEST
    bool "IQS7222D touchpad test input driver"
    depends on I2C && GPIO && INPUT
    depends on DT_HAS_AZOTEQ_IQS7222D_TEST_ENABLED
    help
      Enable a lightweight IQS7222D test driver for bring-up. It verifies I2C
      communication, logs product/status data, and emits horizontal relative
      input from the reported trackpad X coordinate when configured.

if LITOM_IQS7222D_TEST

config LITOM_IQS7222D_TEST_INIT_PRIORITY
    int "IQS7222D test driver init priority"
    default INPUT_INIT_PRIORITY

module = LITOM_IQS7222D_TEST
module-str = litom_iqs7222d_test
source "${ZEPHYR_BASE}/subsys/logging/Kconfig.template.log_config"

endif
```

## config/west.yml
```yaml
manifest:
  remotes:
    - name: cormoran
      url-base: https://github.com/cormoran
    - name: badjeff
      url-base: https://github.com/badjeff
    - name: pukuhei
      url-base: https://github.com/pukuhei
  projects:
    - name: zmk
      remote: cormoran
      revision: e5c9b6915b56801193e359dd9bad4a167ce0d1b8
      import: app/west.yml
    # DYA's Zephyr base, pinned together with the firmware and feature modules.
    - name: zephyr
      remote: cormoran
      revision: 7c6b4cc486ecb41a68d9c2b1def2bb3178fbb826
      import:
        name-blocklist:
          - ci-tools
          - hal_altera
          - hal_cypress
          - hal_infineon
          - hal_microchip
          - hal_nxp
          - hal_openisa
          - hal_xtensa
          - hal_st
          - hal_ti
          - loramac-node
          - mcuboot
          - mcumgr
          - net-tools
          - openthread
          - edtt
          - trusted-firmware-m
    - name: zmk-module-ble-management
      remote: cormoran
      revision: 57738cc4fc6ba80e82a7ac57741a0339cb186cd4
    - name: zmk-module-battery-history
      remote: cormoran
      revision: 307755dd2ad4d320e14de162e8e5ef018f29d929
    - name: zmk-module-settings-rpc
      remote: cormoran
      revision: 78f86df9e6c5edaf57bef3ccbd7f360cfdf49291
    - name: zmk-module-runtime-input-processor
      remote: cormoran
      revision: 43618985f8c9d5457cc333b7ca0733f2d361911e
    - name: zmk-behavior-runtime-sensor-rotate
      remote: cormoran
      revision: 8b1125ed676c1f5e14145d217984f33d0ebdcef4
    - name: zmk-feature-custom-settings
      remote: cormoran
      revision: c6a7fef3a3be3d3ace5de9a4b0628c6418cd1f3f
    - name: zmk-feature-runtime-macro
      remote: cormoran
      revision: 38530962eb7061b60efcb98e84585cfb1f0cb6de
    - name: zmk-feature-runtime-combo
      remote: cormoran
      revision: d9490e7b5d41c516221d131241009e81740efcee
    - name: zmk-feature-default-layer
      remote: cormoran
      revision: b25cb5b324da2d9bbc84e1877c775f5b2b7c6845
    - name: zmk-feature-os-detection
      remote: cormoran
      revision: 3052679f645b8fc1997275c2eaa6b86bdd55ca01
    - name: zmk-pmw3610-driver
      remote: badjeff
      revision: e970029b42f33613ca8f05baf311dc733cd5a390
    - name: zmk-tom-oled
      remote: pukuhei
      revision: b1db06b55bea5bf340760d3a5a7c0b709aa3caa6
  self:
    path: config
```
